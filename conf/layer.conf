## conf/layer.conf
```bitbake
BBFILES += "${LAYERDIR}/recipes-*/*/*.bb \
            ${LAYERDIR}/recipes-*/*/*.bbappend"
BBPATH .= ":${LAYERDIR}"
BBFILE_COLLECTIONS += "qti-qim-product-sdk"
BBFILE_PATTERN_qti-qim-product-sdk := "^${LAYERDIR}/"
BBFILE_PRIORITY_qti-qim-product-sdk = "7"
LAYERSERIES_COMPAT_qti-qim-product-sdk = "kirkstone"

LAYERDEPENDS_qti-qim-product-sdk = "multimedia-layer"

BBFILES_DYNAMIC += " \
    qcom-distro:${LAYERDIR}/dynamic-layers/qcom-distro/*/*/*.bb \
    qcom-distro:${LAYERDIR}/dynamic-layers/qcom-distro/*/*/*.bbappend \
"
```
